/* GPS.G6-SW-10018-F: public CFG sections, port/pulse/protocol selectors,
   NMEA/PUBX and UBX output message rates. ITFM/ESFGWT empty polls are
   compatibility probes (no explicit Poll Request form in this edition).
   CFG-CFG, CFG-NVS and CFG-RST are commands, never polled or sent. */
    {"MON-VER",10,0x04,0,0x00,0x00,40,0},
    {"UART1-BEFORE",6,0x00,1,0x01,0x00,20,1},
    {"NAV-STATUS-BEFORE",1,0x03,0,0x00,0x00,16,0},
    {"NAV-SVINFO-BEFORE",1,0x30,0,0x00,0x00,8,0},
    {"MON-HW-BEFORE",10,0x09,0,0x00,0x00,60,0},
    {"UART1-MASK-SET",6,0x00,20,0x00,0x00,2,2},
    {"UART1-VERIFY",6,0x00,1,0x01,0x00,20,3},
    {"CFG-ANT",6,0x13,0,0x00,0x00,4,0},
    {"CFG-DAT",6,0x06,0,0x00,0x00,52,0},
    {"CFG-EKF",6,0x12,0,0x00,0x00,16,0},
    {"CFG-ESFGWT",6,0x29,0,0x00,0x00,44,0},
    {"CFG-FXN",6,0x0E,0,0x00,0x00,36,0},
    {"CFG-ITFM",6,0x39,0,0x00,0x00,8,0},
    {"CFG-NAV5",6,0x24,0,0x00,0x00,36,0},
    {"CFG-NAVX5",6,0x23,0,0x00,0x00,40,0},
    {"CFG-NMEA",6,0x17,0,0x00,0x00,4,0},
    {"CFG-PM2",6,0x3B,0,0x00,0x00,44,0},
    {"CFG-PM",6,0x32,0,0x00,0x00,24,0},
    {"CFG-RATE",6,0x08,0,0x00,0x00,6,0},
    {"CFG-RINV",6,0x34,0,0x00,0x00,1,0},
    {"CFG-RXM",6,0x11,0,0x00,0x00,2,0},
    {"CFG-SBAS",6,0x16,0,0x00,0x00,8,0},
    {"CFG-TMODE2",6,0x3D,0,0x00,0x00,28,0},
    {"CFG-TMODE",6,0x1D,0,0x00,0x00,28,0},
    {"CFG-TP",6,0x07,0,0x00,0x00,20,0},
    {"CFG-USB",6,0x1B,0,0x00,0x00,108,0},
    {"CFG-PRT-0",6,0x00,1,0x00,0x00,20,0},
    {"CFG-PRT-1",6,0x00,1,0x01,0x00,20,0},
    {"CFG-PRT-2",6,0x00,1,0x02,0x00,20,0},
    {"CFG-PRT-3",6,0x00,1,0x03,0x00,20,0},
    {"CFG-PRT-4",6,0x00,1,0x04,0x00,20,0},
    {"CFG-INF-0",6,0x02,1,0x00,0x00,10,0},
    {"CFG-INF-1",6,0x02,1,0x01,0x00,10,0},
    {"CFG-TP5-0",6,0x31,1,0x00,0x00,32,0},
    {"CFG-TP5-1",6,0x31,1,0x01,0x00,32,0},
    {"MSG-GGA",6,0x01,2,0xF0,0x00,3,0},
    {"MSG-GLL",6,0x01,2,0xF0,0x01,3,0},
    {"MSG-GSA",6,0x01,2,0xF0,0x02,3,0},
    {"MSG-GSV",6,0x01,2,0xF0,0x03,3,0},
    {"MSG-RMC",6,0x01,2,0xF0,0x04,3,0},
    {"MSG-VTG",6,0x01,2,0xF0,0x05,3,0},
    {"MSG-GRS",6,0x01,2,0xF0,0x06,3,0},
    {"MSG-GST",6,0x01,2,0xF0,0x07,3,0},
    {"MSG-ZDA",6,0x01,2,0xF0,0x08,3,0},
    {"MSG-GBS",6,0x01,2,0xF0,0x09,3,0},
    {"MSG-DTM",6,0x01,2,0xF0,0x0A,3,0},
    {"MSG-THS",6,0x01,2,0xF0,0x0E,3,0},
    {"MSG-GPQ",6,0x01,2,0xF0,0x40,3,0},
    {"MSG-TXT",6,0x01,2,0xF0,0x41,3,0},
    {"MSG-PUBX-00",6,0x01,2,0xF1,0x00,3,0},
    {"MSG-PUBX-03",6,0x01,2,0xF1,0x03,3,0},
    {"MSG-PUBX-04",6,0x01,2,0xF1,0x04,3,0},
    {"MSG-PUBX-05",6,0x01,2,0xF1,0x05,3,0},
    {"MSG-PUBX-06",6,0x01,2,0xF1,0x06,3,0},
    {"MSG-PUBX-40",6,0x01,2,0xF1,0x40,3,0},
    {"MSG-PUBX-41",6,0x01,2,0xF1,0x41,3,0},
    {"MSG-ESF-MEAS",6,0x01,2,0x10,0x02,3,0},
    {"MSG-ESF-STATUS",6,0x01,2,0x10,0x10,3,0},
    {"MSG-MON-HW2",6,0x01,2,0x0A,0x0B,3,0},
    {"MSG-MON-HW",6,0x01,2,0x0A,0x09,3,0},
    {"MSG-MON-IO",6,0x01,2,0x0A,0x02,3,0},
    {"MSG-MON-MSGPP",6,0x01,2,0x0A,0x06,3,0},
    {"MSG-MON-RXBUF",6,0x01,2,0x0A,0x07,3,0},
    {"MSG-MON-RXR",6,0x01,2,0x0A,0x21,3,0},
    {"MSG-MON-TXBUF",6,0x01,2,0x0A,0x08,3,0},
    {"MSG-MON-VER",6,0x01,2,0x0A,0x04,3,0},
    {"MSG-NAV-AOPSTATUS",6,0x01,2,0x01,0x60,3,0},
    {"MSG-NAV-CLOCK",6,0x01,2,0x01,0x22,3,0},
    {"MSG-NAV-DGPS",6,0x01,2,0x01,0x31,3,0},
    {"MSG-NAV-DOP",6,0x01,2,0x01,0x04,3,0},
    {"MSG-NAV-EKFSTATUS",6,0x01,2,0x01,0x40,3,0},
    {"MSG-NAV-POSECEF",6,0x01,2,0x01,0x01,3,0},
    {"MSG-NAV-POSLLH",6,0x01,2,0x01,0x02,3,0},
    {"MSG-NAV-SBAS",6,0x01,2,0x01,0x32,3,0},
    {"MSG-NAV-SOL",6,0x01,2,0x01,0x06,3,0},
    {"MSG-NAV-STATUS",6,0x01,2,0x01,0x03,3,0},
    {"MSG-NAV-SVINFO",6,0x01,2,0x01,0x30,3,0},
    {"MSG-NAV-TIMEGPS",6,0x01,2,0x01,0x20,3,0},
    {"MSG-NAV-TIMEUTC",6,0x01,2,0x01,0x21,3,0},
    {"MSG-NAV-VELECEF",6,0x01,2,0x01,0x11,3,0},
    {"MSG-NAV-VELNED",6,0x01,2,0x01,0x12,3,0},
    {"MSG-RXM-ALM",6,0x01,2,0x02,0x30,3,0},
    {"MSG-RXM-EPH",6,0x01,2,0x02,0x31,3,0},
    {"MSG-RXM-RAW",6,0x01,2,0x02,0x10,3,0},
    {"MSG-RXM-SFRB",6,0x01,2,0x02,0x11,3,0},
    {"MSG-RXM-SVSI",6,0x01,2,0x02,0x20,3,0},
    {"MSG-TIM-SVIN",6,0x01,2,0x0D,0x04,3,0},
    {"MSG-TIM-TM2",6,0x01,2,0x0D,0x03,3,0},
    {"MSG-TIM-TP",6,0x01,2,0x0D,0x01,3,0},
    {"MSG-TIM-VRFY",6,0x01,2,0x0D,0x06,3,0},
